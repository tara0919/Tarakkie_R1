## Kconfig
```kconfig
# Copyright (c) 2026 The ZMK Contributors
# SPDX-License-Identifier: MIT

config TARAKKIE_BATTERY_TEXT
    bool "Type both Tarakkie R1 battery levels"
    default y
    depends on SHIELD_TARAKKIE_R1_LEFT
    depends on ZMK_BATTERY_REPORTING
    depends on ZMK_SPLIT_ROLE_CENTRAL
    depends on ZMK_SPLIT_BLE_CENTRAL_BATTERY_LEVEL_FETCHING
```

## config/boards/shields/tarakkie_R1/Kconfig.defconfig
```kconfig
# Copyright (c) 2025 The ZMK Contributors
# SPDX-License-Identifier: MIT

if SHIELD_TARAKKIE_R1_LEFT

config ZMK_KEYBOARD_NAME
    default "Tarakkie R1"

config ZMK_SPLIT_ROLE_CENTRAL
    default y

config ZMK_SPLIT_BLE_CENTRAL_PERIPHERALS
    default 2

config BT_MAX_CONN
    default 7

config BT_MAX_PAIRED
    default 7

config ZMK_SPLIT_BLE_CENTRAL_BATTERY_LEVEL_FETCHING
    default y

config ZMK_SPLIT_BLE_CENTRAL_BATTERY_LEVEL_PROXY
    default y

endif

if SHIELD_TARAKKIE_R1_LEFT || SHIELD_TARAKKIE_R1_RIGHT || SHIELD_TARAKKIE_R1_TRACKBALL

config ZMK_SPLIT
    default y

endif

if SHIELD_TARAKKIE_R1_LEFT || SHIELD_TARAKKIE_R1_TRACKBALL

config INPUT
    default y

config ZMK_POINTING
    default y

endif
```

## config/west.yml
```yaml
manifest:
  defaults:
    revision: v0.3
  remotes:
    - name: zmkfirmware
      url-base: https://github.com/zmkfirmware
    - name: badjeff
      url-base: https://github.com/badjeff
    # See https://docs.zephyrproject.org/3.2.0/develop/west/manifest.html#projects
  projects:
    - name: zmk
      remote: zmkfirmware
      import: app/west.yml
    - name: zmk-pmw3610-driver
      remote: badjeff
      revision: zmk-0.3
      path: zmk-pmw3610-driver-src
    - name: zmk-split-peripheral-input-relay
      remote: badjeff
      revision: main
    - name: zmk-rgbled-widget
      url: https://github.com/caksoylar/zmk-rgbled-widget
      revision: v0.3
  self:
    path: config
```
