## config/boards/shields/tarakkie_R1/Kconfig.shield
```kconfig
# Copyright (c) 2025 The ZMK Contributors
# SPDX-License-Identifier: MIT

config SHIELD_TARAKKIE_R1_LEFT
    def_bool $(shields_list_contains,tarakkie_R1_left)

config SHIELD_TARAKKIE_R1_RIGHT
    def_bool $(shields_list_contains,tarakkie_R1_right)
```
